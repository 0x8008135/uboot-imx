## board/technexion/edm-g-imx8mp/Kconfig
```kconfig
if TARGET_EDM_G_IMX8MP

config SYS_BOARD
	default "edm-g-imx8mp"

config SYS_VENDOR
	default "technexion"

config SYS_CONFIG_NAME
	default "edm-g-imx8mp"

config IMX_CONFIG
	default "board/phytec/phycore_imx8mp/imximage-8mp-sd.cfg"

source "board/technexion/common/Kconfig"

endif
```
